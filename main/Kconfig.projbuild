## main/Kconfig.projbuild
```kconfig
menu "MRRC Terminal"

    config MRRC_WIFI_SSID
        string "Wi-Fi SSID"
        default ""

    config MRRC_WIFI_PASSWORD
        string "Wi-Fi password"
        default ""

    config MRRC_SERVER_HOST
        string "MRRC server host"
        default ""

    config MRRC_SERVER_PORT
        int "MRRC server port"
        default 443

    config MRRC_SERVER_PASSWORD
        string "MRRC web password"
        default ""

    config MRRC_AUDIO_HZ
        int "Codec sample rate"
        default 16000
        help
            The ES8311 shares MCLK/BCLK/WS, so both directions run at one rate.
            16 kHz is required, not a preference: measured on this board the
            ADC delivers peak 468 at 48 kHz vs 12708 at 16 kHz for the same
            speech.  The downlink decimates 3:1 after Opus decode and the
            uplink upsamples 3:1 back to 48 kHz for the server.

    config MRRC_PTT_SELFTEST
        bool "Key the transmitter once, automatically, after boot"
        default n
        help
            Waits for the control link, then runs exactly the same sequence the
            OK long-press runs (suspend downlink -> ptt:true -> open audioTX ->
            5 s -> unkey -> resume).  Saves asking a human to hold a button
            while reading a serial log.

    config MRRC_PROFILE
        bool "Runtime profiling (per-task CPU, decode cost, heap high-water)"
        default n
        help
            Prints a per-task CPU breakdown (FreeRTOS run-time stats), the
            average opus_decode() cost per frame, and heap high-water marks once
            a minute.  Run-time stats charge every tick, so this is off in
            shipping builds; turn it on when you need numbers instead of
            intuition.

endmenu
```
